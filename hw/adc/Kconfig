## hw/xtensa/Kconfig
```kconfig
config XTENSA_SIM
    default y
    depends on XTENSA
    bool

config XTENSA_VIRT
    bool
    default y
    depends on XTENSA
    select XTENSA_SIM
    select PCI_EXPRESS_GENERIC_BRIDGE
    select PCI_DEVICES

config XTENSA_XTFPGA
    bool
    default y
    depends on XTENSA && FDT
    select DEVICE_TREE
    select OPENCORES_ETH
    select PFLASH_CFI01
    select SERIAL_MM

config XTENSA_ESP32
    bool
    default y
    depends on XTENSA
    select SSI
    select SSI_M25P80
    select UNIMP
    select OPENCORES_ETH
    select DWC_SDMMC
    select TMP105
    select LED
    select ESP_RGB

config XTENSA_ESP32S3
    bool
    default y
    depends on XTENSA
    select SSI
    select SSI_M25P80
    select UNIMP
    select OPENCORES_ETH
    select DWC_SDMMC
    select TMP105
    select ESP_RGB

config M5PAPER
    bool
    default y
    select XTENSA_ESP32
    select IT8951E
    select GT911
    select SSI_SD
    select ESP32_ADC
    select M5PAPER_BTN
    select PCF8563_RTC
```
